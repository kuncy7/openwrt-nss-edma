// SPDX-License-Identifier: GPL-2.0-or-later OR MIT

/dts-v1/;

#include "ipq5018-tplink-ax5x-256m.dtsi"

/ {
	model = "TP-Link Archer AX58 v2";
	compatible = "tplink,archer-ax58-v2", "qcom,ipq5018";
};

&wifi {
	qcom,ath11k-calibration-variant = "TP-Link-Archer-AX58-v2";
};

&wifi1 {
	qcom,ath11k-calibration-variant = "TP-Link-Archer-AX58-v2";
};
